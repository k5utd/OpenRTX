## platform/targets/cobalt-cowboy/Kconfig.defconfig
```kconfig
# K5UTD SPUR-SBR board configuration

# SPDX-License-Identifier: GPL-3.0-only

config BOARD
	default "K5UTD_COBALT_COWBOY"
	depends on BOARD_K5UTD_COBALT_COWBOY

config HEAP_MEM_POOL_SIZE
	default 98304 if WIFI
	default 40960 if BT
	default 4096

choice BT_HCI_BUS_TYPE
	default BT_ESP32 if BT
endchoice
```

## platform/targets/cobalt-cowboy/Kconfig.sysbuild
```kconfig
# SPDX-License-Identifier: GPL-3.0-only

choice BOOTLOADER
	default BOOTLOADER_MCUBOOT
endchoice

choice BOOT_SIGNATURE_TYPE
	default BOOT_SIGNATURE_TYPE_NONE
endchoice
```

## platform/targets/cobalt-cowboy/cobalt-cowboy_defconfig
```kconfig
CONFIG_SOC_SERIES_ESP32C3=y
CONFIG_BOOTLOADER_MCUBOOT=y
CONFIG_GPIO=y
CONFIG_SPI=y
```

## platform/targets/spur-sbr/Kconfig.board
```kconfig
# K5UTD SPUR-SBR board configuration

# SPDX-License-Identifier: GPL-3.0-only
# TODO: TAPR-OHL-1.0?

config BOARD_K5UTD_SPUR-SBR
	bool "K5UTD SPUR-SBR Board"
	depends on SOC_SERIES_ESP32C3

choice SOC_PART_NUMBER
	default SOC_ESP32C3_WROOM_N4
endchoice
```
